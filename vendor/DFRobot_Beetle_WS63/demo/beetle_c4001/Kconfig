## vendor/DFRobot_Beetle_WS63/demo/beetle_c4001/Kconfig
```kconfig
#===============================================================================
# @brief    Kconfig file.
# Copyright (c) HiSilicon (Shanghai) Technologies Co., Ltd. 2023-2023. All rights reserved.
#===============================================================================
choice
    prompt "Select Motion Detection or Range Velocity Sample"
	default SAMPLE_SUPPORT_MOTION_SAMPLE
	config SAMPLE_SUPPORT_MOTION_SAMPLE
		bool "Support Motion Detection Sample."

	config SAMPLE_SUPPORT_MRANGE_SAMPLE
		bool "Support Range Velocity Sample."

endchoice

config UART_BUS_ID
    int "Choose UART BUS id."
    default 2    

config RADAR_UART_BAUD
    int "Choose UART baud."
    default 9600    

config RADAR_UART_TX_PIN
    int "Choose UART TX pin."
    default 8   

config RADAR_UART_RX_PIN
    int "Choose UART RX pin."
    default 7
    
```

## vendor/DFRobot_Beetle_WS63/demo/beetle_df9gms/Kconfig
```kconfig
#===============================================================================
# @brief    Kconfig file.
# Copyright (c) HiSilicon (Shanghai) Technologies Co., Ltd. 2023-2023. All rights reserved.
#===============================================================================

config DF9GMS_PIN
    int "Choose DF9GMS pin."
    default 2
```

## vendor/DFRobot_Beetle_WS63/demo/beetle_ds18b20/Kconfig
```kconfig
#===============================================================================
# @brief    Kconfig file.
# Copyright (c) HiSilicon (Shanghai) Technologies Co., Ltd. 2023-2023. All rights reserved.
#===============================================================================

config ONEWIRE_PIN
    int "Choose DS18B20 pin."
    default 2
```

## vendor/DFRobot_Beetle_WS63/demo/beetle_lis2dh12/Kconfig
```kconfig
#===============================================================================
# @brief    Kconfig file.
# Copyright (c) HiSilicon (Shanghai) Technologies Co., Ltd. 2023-2023. All rights reserved.
#===============================================================================
choice
    prompt "Select getAcceleration or interrupt Sample"
	default SAMPLE_SUPPORT_ACCELERATION_SAMPLE
	config SAMPLE_SUPPORT_ACCELERATION_SAMPLE
		bool "Support getAcceleration Sample."

	config SAMPLE_SUPPORT_INTERRUPT_SAMPLE
		bool "Support interrupt Sample."

endchoice

config I2C_MASTER_BUS_ID
    int "Choose I2C bus id."
    default 1

config I2C_SCL_MASTER_PIN
    int "Choose I2C SCL pin"
    default 16

config I2C_SDA_MASTER_PIN
    int "Choose I2C SDA pin"
    default 15

config I2C_SLAVE_ADDR
    int "Choose I2C SLAVE ADDR"
    default 0x18

config INTERRUPT_PIN
    int "Choose INTERRUPT pin"
    default 2
	depends on SAMPLE_SUPPORT_INTERRUPT_SAMPLE
```

## vendor/DFRobot_Beetle_WS63/demo/beetle_mqtt/Kconfig
```kconfig
#===============================================================================
# @brief    Kconfig file.
# Copyright (c) HiSilicon (Shanghai) Technologies Co., Ltd. 2023-2023. All rights reserved.
#===============================================================================

config SERVER_IP_ADDR
    string "Set MQTT server ip addr."
    default "192.168.x.x"

config WIFI_SSID
    string "Set WIFI_SSID."
    default "wifi_account"

config WIFI_PWD
    string "Set WIFI_PWD."
    default "wifi_pwd"

config MQTT_TOPIC_SUB
    string "Set MQTT_TOPIC_SUB."
    default "subTopic"

config MQTT_TOPIC_PUB
    string "Set MQTT_TOPIC_PUB."
    default "pubTopic"

config MQTT_PUB_MSG
    string "Set MQTT_PUB_MSG."
    default "hello!"

config MQTT_AUTH_ENABLE
    bool "Enable MQTT Authentication"
    default n
    help
      Enable MQTT username and password authentication

config MQTT_USERNAME
    string "Set MQTT username"
    default "mqtt_user"
    depends on MQTT_AUTH_ENABLE

config MQTT_PASSWORD
    string "Set MQTT password"
    default "mqtt_pass"
    depends on MQTT_AUTH_ENABLE
```

## vendor/DyCloud_WF6301_DK V1.0/demo/button_interrupt/Kconfig
```kconfig
config BUTTON_PIN
    int
    prompt "Choose BUTTON_PIN pin."
    depends on SAMPLE_SUPPORT_BUTTON_INTERRUPT
    default 12
```

## vendor/Lierda-FB36/demo/key/Kconfig
```kconfig
#===============================================================================
# @brief    Kconfig file.
# Copyright (c) HiSilicon (Shanghai) Technologies Co., Ltd. 2024-2024. All rights reserved.
#===============================================================================
config KEY_PIN
    int
    prompt "Choose KEY pin."
    default 12
```

## vendor/Lierda-FB36/demo/led/Kconfig
```kconfig
#===============================================================================
# @brief    Kconfig file.
# Copyright (c) HiSilicon (Shanghai) Technologies Co., Ltd. 2024-2024. All rights reserved.
#===============================================================================
config LED_PIN
    int
    prompt "Choose LED pin."
    default 4
```

## vendor/developers/demo/lcd_st7789_lvgl9/spi/Kconfig
```kconfig
config SPI_MASTER_BUS_ID
    int
    prompt "Choose SPI master bus id."
    depends on SAMPLE_SUPPORT_SPI
    default 0

config SPI_DI_MASTER_PIN
    int
    prompt "Choose SPI DI master pin."
    depends on SAMPLE_SUPPORT_SPI
    default 11

config SPI_DO_MASTER_PIN
    int
    prompt "Choose SPI DO master pin."
    depends on SAMPLE_SUPPORT_SPI
    default 9

config SPI_CLK_MASTER_PIN
    int
    prompt "Choose SPI CLK master pin."
    depends on SAMPLE_SUPPORT_SPI
    default 7

config SPI_CS_MASTER_PIN
    int
    prompt "Choose SPI CS master pin."
    depends on SAMPLE_SUPPORT_SPI
    default 10

config SPI_RESET_MASTER_PIN
    int
    prompt "Choose SPI RESET master pin."
    depends on SAMPLE_SUPPORT_SPI
    default 3

config SPI_DC_MASTER_PIN
    int
    prompt "Choose SPI DC master pin."
    depends on SAMPLE_SUPPORT_SPI
    default 6
```
