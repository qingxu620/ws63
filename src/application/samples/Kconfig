## src/ws63_laser_sle_job/Kconfig
```kconfig
#===============================================================================
# @brief WS63 structured SLE laser job Kconfig
#===============================================================================

menu "WS63 SLE 离线任务包激光打标配置"
    depends on ENABLE_LASER_SLE_JOB_SAMPLE

choice
    prompt "SLE 任务板角色选择"
    default LASER_SLE_JOB_RECEIVER

config LASER_SLE_JOB_RECEIVER
    bool "构建接收板固件（RX：缓存、校验、执行）"
    select SPI_SUPPORT_MASTER
    help
        选择构建接收板（RX）固件。
        接收板负责接收SLE结构化任务包，缓存完整的G-code任务，
        进行CRC/偏移/序列号校验，通过后本地执行打标任务。

config LASER_SLE_JOB_TRANSMITTER
    bool "构建发射板固件（TX：串口输入转SLE包）"
    help
        选择构建发射板（TX）固件。
        发射板从串口读取PC上位机的自定义协议数据，
        封装为SLE结构化包发送给接收板。不模拟Grbl协议。

endchoice

comment "当前构建目标：接收板固件（RX）"
    depends on LASER_SLE_JOB_RECEIVER

comment "当前构建目标：发射板固件（TX）"
    depends on LASER_SLE_JOB_TRANSMITTER

config LASER_SLE_JOB_CACHE_SIZE
    int "接收板G-code任务缓存大小（字节）"
    default 65536
    range 4096 262144
    help
        设置接收板RAM中用于缓存G-code任务的空间大小。
        单位为字节，范围4KB-256KB。
        根据任务复杂度和内存情况调整，默认64KB。

comment "发射板串口配置（连接PC上位机）"
config LASER_SLE_JOB_UART_BAUD
    int "PC上位机串口波特率"
    range 9600 1000000
    default 115200
    help
        设置发射板与PC上位机通信的串口波特率。
        默认115200，需与上位机设置一致。

config LASER_SLE_JOB_UART_BUS
    int "PC上位机串口总线号"
    default 1
    help
        设置使用的UART总线编号（0, 1, 2）。
        默认使用UART1。

config LASER_SLE_JOB_UART_TX_PIN
    int "PC上位机串口TX引脚"
    default 15
    help
        设置串口发送引脚的GPIO编号。
        默认GPIO15，需与硬件连接一致。

config LASER_SLE_JOB_UART_RX_PIN
    int "PC上位机串口RX引脚"
    default 16
    help
        设置串口接收引脚的GPIO编号。
        默认GPIO16，需与硬件连接一致。

config LASER_SLE_JOB_WORK_AREA_X_MM
    int "X轴工作区域（mm）"
    range 1 300
    default 70

config LASER_SLE_JOB_WORK_AREA_Y_MM
    int "Y轴工作区域（mm）"
    range 1 300
    default 70

endmenu
```

## src/ws63_laser_sle_tx/Kconfig
```kconfig
#===============================================================================
# @brief WS63 structured SLE laser TX Kconfig
#===============================================================================

menu "WS63 SLE TX 离线任务发送板配置"
    depends on ENABLE_LASER_SLE_JOB_SAMPLE

config LASER_SLE_JOB_TRANSMITTER
    bool "构建发射板固件（TX：串口输入转SLE包）"
    default y
    help
        选择构建发射板（TX）固件。
        发射板从串口读取PC上位机的自定义协议数据，
        封装为SLE结构化包发送给接收板。不模拟Grbl协议。

comment "当前构建目标：发射板固件（TX）"
    depends on LASER_SLE_JOB_TRANSMITTER

comment "发射板串口配置（连接PC上位机）"
config LASER_SLE_JOB_UART_BAUD
    int "PC上位机串口波特率"
    range 9600 1000000
    default 115200
    help
        设置发射板与PC上位机通信的串口波特率。
        默认115200，需与上位机设置一致。

config LASER_SLE_JOB_UART_BUS
    int "PC上位机串口总线号"
    default 1
    help
        设置使用的UART总线编号（0, 1, 2）。
        默认使用UART1。

config LASER_SLE_JOB_UART_TX_PIN
    int "PC上位机串口TX引脚"
    default 15
    help
        设置串口发送引脚的GPIO编号。
        默认GPIO15，需与硬件连接一致。

config LASER_SLE_JOB_UART_RX_PIN
    int "PC上位机串口RX引脚"
    default 16
    help
        设置串口接收引脚的GPIO编号。
        默认GPIO16，需与硬件连接一致。

endmenu
```

## src/ws63_laser_wifi/Kconfig
```kconfig
menu "WS63 WiFi 实时激光打标配置"

config LASER_WIFI_AP_SSID
    string "WiFi 热点名称（SSID）"
    default "WS63_LASER_WIFI"
    help
        设置激光控制器创建的WiFi热点名称。
        设备将以此名称广播，供电脑或手机连接。

config LASER_WIFI_AP_PSK
    string "WiFi 热点密码"
    default "12345678"
    help
        设置WiFi热点的WPA/WPA2密码。
        密码长度至少8位，建议使用强密码保障安全。

config LASER_WIFI_AP_CHANNEL
    int "WiFi 热点信道"
    range 1 13
    default 13
    help
        设置WiFi热点使用的信道。
        信道1-13可选，建议选择干扰较少的信道。
        默认使用信道13。

config LASER_WIFI_TCP_PORT
    int "TCP 服务端口"
    default 5000
    help
        设置TCP服务器监听的端口号。
        LaserGRBL通过Telnet协议连接此端口进行通信。
        默认端口5000，可根据需要修改。

config LASER_WIFI_WORK_AREA_X_MM
    int "X轴工作区域（mm）"
    default 70

config LASER_WIFI_WORK_AREA_Y_MM
    int "Y轴工作区域（mm）"
    default 70

config LASER_WIFI_STATUS_PERIODIC
    bool "启用周期性状态报告"
    default n
    help
        启用后，控制器在连接状态下会定期发送Grbl状态报告。
        通常LaserGRBL会主动发送'?'查询状态，此选项一般不需要开启。

endmenu
```

## src/ws63_laser_wireless/Kconfig
```kconfig
#===============================================================================
# @brief WS63 wireless laser marker Kconfig
#===============================================================================

menu "WS63 Wireless Laser Marker Configuration (隔离版无线打标配置)"
    depends on ENABLE_LASER_WIRELESS_SAMPLE

comment "Current role: RECEIVER / 接收板（连接振镜、激光、DAC/PWM）"
    depends on LASER_WIRELESS_RECEIVER

comment "Current role: TRANSMITTER / 发射板（连接LaserGRBL串口，负责星闪转发）"
    depends on LASER_WIRELESS_TRANSMITTER

comment "Fixed pins: UART1 GPIO15/16, SPI0 GPIO7/9/10, PWM2 GPIO2（固定接线）"

config LASER_WIRELESS_UART_BAUD
    int
    prompt "LaserGRBL debug UART baud rate (LaserGRBL调试串口波特率)"
    range 9600 1000000
    default 115200

config LASER_WIRELESS_WORK_AREA_X_MM
    int
    prompt "Work area X size in mm (X轴工作幅面mm)"
    range 1 300
    default 70

config LASER_WIRELESS_WORK_AREA_Y_MM
    int
    prompt "Work area Y size in mm (Y轴工作幅面mm)"
    range 1 300
    default 70

config LASER_WIRELESS_STATUS_PERIODIC
    bool
    prompt "Send periodic Grbl status reports on debug UART (调试串口周期输出Grbl状态)"
    default n

endmenu
```

## src/ws63_screen_lvgl/Kconfig
```kconfig
#===============================================================================
# @brief WS63 LVGL minimal port Kconfig
#===============================================================================

menu "WS63 LVGL 配置"
    depends on ENABLE_LVGL_SAMPLE

config LVGL_DISP_BUF_LINES
    int "LVGL 显示缓冲区行数"
    default 48
    range 10 480
    help
        LVGL 显示缓冲区大小 = 320 * N 行 * 2 字节。
        默认 48 行 = 30720 字节。

endmenu
```

## src/ws63_sle_laser/Kconfig
```kconfig
#===============================================================================
# @brief WS63 SLE Laser Marker Kconfig
#===============================================================================

menu "WS63 SLE Laser Configuration"
    depends on ENABLE_SLE_LASER_SAMPLE

choice
    prompt "SLE Laser board role (板卡角色)"
    default SLE_LASER_RECEIVER

config SLE_LASER_RECEIVER
    bool "Build RECEIVER firmware (接收板：连接振镜/激光，执行打标)"
    select SPI_SUPPORT_MASTER
    help
        Build receiver firmware. Receives G-code via SLE and executes
        laser marking using the same logic as ws63_laser_single.

config SLE_LASER_TRANSMITTER
    bool "Build TRANSMITTER firmware (发射板：连接LaserGRBL，透传G-code)"
    help
        Build transmitter firmware. Receives G-code from UART and
        forwards it to receiver via SLE. No G-code parsing, just passthrough.

endchoice

comment "CURRENT BUILD TARGET: RECEIVER / 接收板固件"
    depends on SLE_LASER_RECEIVER

comment "CURRENT BUILD TARGET: TRANSMITTER / 发射板固件"
    depends on SLE_LASER_TRANSMITTER

comment "UART configuration"
config SLE_LASER_UART_BAUD
    int
    prompt "UART baud rate"
    range 9600 1000000
    default 115200

config SLE_LASER_UART_BUS
    int
    prompt "UART bus number"
    default 1

config SLE_LASER_UART_TX_PIN
    int
    prompt "UART TX pin"
    default 15

config SLE_LASER_UART_RX_PIN
    int
    prompt "UART RX pin"
    default 16

comment "Laser work area"
config SLE_LASER_WORK_AREA_X_MM
    int
    prompt "Work area X size in mm"
    range 1 300
    default 70

config SLE_LASER_WORK_AREA_Y_MM
    int
    prompt "Work area Y size in mm"
    range 1 300
    default 70

endmenu
```

## src/ws63_test/Kconfig
```kconfig
#===============================================================================
# @brief    WS63 Laser Marker Kconfig
#===============================================================================

choice
    prompt "Board Role (板卡角色)"
    depends on ENABLE_LASER_MARKER_SAMPLE

config LASER_MARKER_RECEIVER
    bool "Support Receiver Board (接收板)."
    select SPI_SUPPORT_MASTER

config LASER_MARKER_TRANSMITTER
    bool "Support Transmitter Board (发射板)."

config LASER_MARKER_FOCUS_NODE
    bool "Support Focus Node Board (感知与对焦节点，含Z轴/ZDT)."

config LASER_MARKER_SAFETY_NODE
    bool "Support Safety Node Board (安全终端节点)."

endchoice

if LASER_MARKER_RECEIVER
menu "Receiver Configuration (接收配置)"

comment "Fixed pins: SPI0 / GPIO10 / PWM2（固定接线）"

endmenu
endif

if LASER_MARKER_TRANSMITTER
menu "Transmitter Configuration (发射配置)"

comment "Fixed UART: UART1 / GPIO15-16（固定串口）"

config LASER_WIFI_SOFTAP_ENABLE
    bool
    prompt "Support WiFi (启用WiFi)."
    default y
    help
        This option means enable WiFi function on Transmitter.

if LASER_WIFI_SOFTAP_ENABLE
menu "WiFi Configuration (WiFi设置)"

choice
    prompt "WiFi Mode (模式)"
    default LASER_WIFI_MODE_SOFTAP

config LASER_WIFI_MODE_SOFTAP
    bool "Support WiFi SoftAP Mode (热点模式)."

config LASER_WIFI_MODE_STA
    bool "Support WiFi STA Mode (联网模式)."

endchoice

config LASER_WIFI_SOFTAP_SSID
    string
    prompt "Set SoftAP SSID (热点名)."
    default "WS63_LaserTX"
    depends on LASER_WIFI_MODE_SOFTAP

config LASER_WIFI_SOFTAP_PSK
    string
    prompt "Set SoftAP Password (热点密码)."
    default "ws63laser"
    depends on LASER_WIFI_MODE_SOFTAP

config LASER_WIFI_SOFTAP_CHANNEL
    int
    prompt "Choose SoftAP Channel (信道)."
    range 1 13
    default 13
    depends on LASER_WIFI_MODE_SOFTAP

config LASER_WIFI_STA_SSID
    string
    prompt "Set STA SSID (路由器名)."
    default "YourRouterSSID"
    depends on LASER_WIFI_MODE_STA

config LASER_WIFI_STA_PSK
    string
    prompt "Set STA Password (路由器密码)."
    default "routerpass"
    depends on LASER_WIFI_MODE_STA

config LASER_WIFI_TCP_PORT
    int
    prompt "Choose TCP Port (端口)."
    range 1 65535
    default 5000

endmenu
endif

endmenu
endif

if LASER_MARKER_FOCUS_NODE
menu "Focus Node Configuration (感知与对焦节点配置)"

comment "Current Z-axis path is fixed to TTL UART1 / GPIO15-16（当前Z轴固定为TTL串口 UART1 / GPIO15-16）"

config ZDT_UART_BAUD
    int
    prompt "UART baud rate (UART波特率)."
    range 9600 1000000
    default 115200

config ZDT_DEVICE_ADDR
    int
    prompt "ZDT motor address (ZDT电机地址)."
    range 0 255
    default 1

config ZDT_RS485_DIR_ENABLE
    bool
    prompt "Use RS485 DE/RE direction pin (启用RS485方向控制)."
    default n

if ZDT_RS485_DIR_ENABLE
config ZDT_RS485_DIR_PIN
    int
    prompt "RS485 DE/RE pin (RS485方向引脚)."
    range 0 31
    default 17

config ZDT_RS485_DIR_ACTIVE_HIGH
    bool
    prompt "DE active high (DE高电平发送)."
    default y
endif

config ZDT_DEMO_AUTO_RUN
    bool
    prompt "Auto-run demo move after boot (上电自动演示运动)."
    default n
    help
        Enable a minimal smoke test sequence:
        motor enable -> position clear -> one relative move.
        Keep this disabled on real Z-axis hardware until limits are verified.

config FOCUS_NODE_BOOT_ENABLE_Z
    bool
    prompt "Enable Z motor after focus node boot (感知节点启动后自动使能Z轴)."
    default y

config FOCUS_NODE_BOOT_SYNC_ZERO
    bool
    prompt "Clear Z position once after boot (感知节点启动后执行一次位置清零)."
    default y

endmenu
endif

if LASER_MARKER_SAFETY_NODE
menu "Safety Node Configuration (安全节点配置)"

config SAFETY_NODE_LED_PIN
    int
    prompt "Safety node LED pin (安全节点LED引脚)."
    range 0 31
    default 7

config SAFETY_NODE_LED_ACTIVE_HIGH
    bool
    prompt "LED active high (LED高电平点亮)."
    default y

config SAFETY_NODE_BOOT_LED_ON
    bool
    prompt "Turn LED on after boot (安全节点启动后点亮LED)."
    default n

endmenu
endif
```

## src/ws63_wenxuan/Kconfig
```kconfig
#===============================================================================
# @brief WS63 unified laser RX configuration
#===============================================================================

menu "WS63 Laser RX Wenxuan Options"
    depends on LASER_RX_WENXUAN

config LASER_RX_TRANSPORT_UART
    bool "Enable legacy USART route option"
    default n
    help
        R2A compiles the prefixed legacy USART route copied from
        ws63_laser_single, but the integrated main entry does not start the
        UART RX task yet.

config LASER_RX_UART_BAUD
    int "Legacy USART route baud rate"
    default 115200
    depends on LASER_RX_TRANSPORT_UART
    help
        UART baud rate for the direct PC-to-RX command stream. Keep 115200 for
        the demo-safe baseline unless explicitly testing a rebuilt firmware.

config LASER_RX_UART_STATUS_PERIODIC
    bool "Enable periodic status reports for legacy USART route"
    default n
    depends on LASER_RX_TRANSPORT_UART
    help
        Keep disabled for LaserGRBL by default; LaserGRBL normally polls with '?'.

config LASER_RX_TRANSPORT_WIFI
    bool "Enable legacy WiFi route option"
    default n
    help
        R3A compiles the prefixed legacy WiFi route copied from
        ws63_laser_wifi, but the integrated main entry does not start SoftAP,
        the TCP server, or a WiFi task yet.

config LASER_RX_TRANSPORT_SLE_JOB
    bool "Enable SLE job route option"
    default n
    help
        R4B starts the route-local SLE receiver, packet/cache state machine,
        G-code processor, motion executor, and SLE server as the default active
        route. Legacy UART/WiFi routes remain compiled but inactive.

config LASER_RX_SLE_JOB_CACHE_SIZE
    int "Integrated SLE job cache size"
    default 102400
    range 102400 102400
    depends on LASER_RX_TRANSPORT_SLE_JOB
    help
        Keep the product SLE RX cache at 100KiB. Larger Host jobs must be
        streamed with upload-and-execute or rejected before upload so RX cannot
        overflow the task cache.

config LASER_RX_WORK_AREA_X_MM
    int "Work area X in mm"
    default 99

config LASER_RX_WORK_AREA_Y_MM
    int "Work area Y in mm"
    default 99

endmenu
```
