## src/application/samples/Kconfig
```kconfig
#===============================================================================
# @brief    Kconfig file.
# Copyright (c) HiSilicon (Shanghai) Technologies Co., Ltd. 2023-2023. All rights reserved.
#===============================================================================

config ENABLE_BT_SAMPLE
    bool
    prompt "Enable the Sample of BT."
    default n
    depends on SAMPLE_ENABLE
    help
        This option means enable the sample of BT.

if ENABLE_BT_SAMPLE
osource "application/samples/bt/Kconfig"
endif

config ENABLE_PERIPHERAL_SAMPLE
    bool
    prompt "Enable the Sample of peripheral."
    default n
    depends on SAMPLE_ENABLE
    help
        This option means enable the sample of peripheral.

if ENABLE_PERIPHERAL_SAMPLE
osource "application/samples/peripheral/Kconfig"
endif

config ENABLE_WIFI_SAMPLE
    bool
    prompt "Enable the Sample of WIFI."
    default n
    depends on SAMPLE_ENABLE
    help
        This option means enable the sample of WIFI.

if ENABLE_WIFI_SAMPLE
osource "application/samples/wifi/Kconfig"
endif

config ENABLE_PRODUCTS_SAMPLE
    bool
    prompt "Enable the Sample of products."
    default n
    depends on SAMPLE_ENABLE
    help
        This option means enable the sample of products.

if ENABLE_PRODUCTS_SAMPLE
osource "application/samples/products/Kconfig"
endif

config ENABLE_RADAR_SAMPLE
    bool
    prompt "Enable the Sample of RADAR."
    default n
    depends on SAMPLE_ENABLE
    help
        This option means enable the sample of RADAR.

if ENABLE_RADAR_SAMPLE
osource "application/samples/radar/Kconfig"
endif

config ENABLE_NFC_SAMPLE
    bool
    prompt "Enable the Sample of NFC."
    default n
    depends on SAMPLE_ENABLE
    help
        This option means enable the sample of NFC.

if ENABLE_NFC_SAMPLE
osource "application/samples/nfc/Kconfig"
endif

comment "WS63 激光打标工程：串口基线 / WiFi实时 / SLE离线任务"

config ENABLE_LASER_SINGLE_SAMPLE
    bool
    prompt "WS63 串口单板激光打标（有线基线）"
    default n
    depends on SAMPLE_ENABLE
    select SPI_SUPPORT_MASTER
    help
        用途：最稳定的有线串口基线工程。
        电脑通过 USB/串口直接连接接收板，接收板本地完成 G-code 解析、
        振镜运动和激光控制。适合验证底层运动、DAC、PWM、激光关断等核心逻辑。

if ENABLE_LASER_SINGLE_SAMPLE
source "deprecated/ws63_laser_single/Kconfig"
endif

config ENABLE_LASER_WIFI_SAMPLE
    bool
    prompt "WS63 WiFi 实时激光打标（SoftAP/TCP）"
    default n
    depends on SAMPLE_ENABLE
    select SPI_SUPPORT_MASTER
    help
        用途：当前无线实时打标主线工程。
        接收板开启 WiFi SoftAP，并在 TCP 端口提供 Grbl/Telnet 服务。
        LaserGRBL 可通过 IP:PORT 直接连接，适合实时无线打标。

if ENABLE_LASER_WIFI_SAMPLE
source "deprecated/ws63_laser_wifi/Kconfig"
endif

config ENABLE_LASER_SLE_JOB_SAMPLE
    bool
    prompt "WS63 SLE 离线任务包激光打标（TX/RX + 自建上位机）"
    default n
    depends on SAMPLE_ENABLE
    help
        用途：SLE 结构化任务包工程，不兼容 LaserGRBL 实时串口协议。
        PC 自建上位机通过串口把完整 G-code 任务发给 TX，TX 封装为 SLE
        标准包下发给 RX，RX 缓存完整任务、校验通过后本地执行。

if ENABLE_LASER_SLE_JOB_SAMPLE
source "ws63_laser_sle_tx/Kconfig"
endif

config LASER_RX_UNIFIED
    bool
    prompt "WS63 RX 三模融合骨架（USART / WiFi / SLE）"
    default n
    depends on SAMPLE_ENABLE
    select SPI_SUPPORT_MASTER
    help
        用途：新的 route-based 统一 RX 固件主线。目标是最终融合 USART Direct、
        WiFi TCP 和 SLE job packet 三种 route，同时复用入口、route manager、
        safety/status 和构建流程。当前 R1 只编译 route manager stub，不启动真实 route。

if LASER_RX_UNIFIED
source "ws63_laser_rx_unified/Kconfig"
endif

comment "WS63 LVGL 模块：LVGL v9.3.0 + MSP3223 target"

config ENABLE_LVGL_SAMPLE
    bool
    prompt "WS63 LVGL 最小移植（MSP3223 target + LVGL v9.3.0）"
    default n
    depends on SAMPLE_ENABLE
    select SPI_SUPPORT_MASTER
    help
        用途：LVGL v9.3.0 最小移植验证。
        临时复用 deprecated/ws63_screen_st7796_ft6336 的历史 LCD/触摸驱动，
        显示 WS63 Laser Panel demo 页面。
        注意：与 ENABLE_SCREEN_SAMPLE 互斥（共用硬件）。

if ENABLE_LVGL_SAMPLE
source "deprecated/ws63_screen_panel_lvgl/Kconfig"
endif

config ENABLE_LVGL_PANEL
    bool
    prompt "WS63 工业中控面板 UI（MSP3223 target + LVGL v9.3.0）"
    default n
    depends on SAMPLE_ENABLE
    select SPI_SUPPORT_MASTER
    help
        用途：工业风格中控面板 UI，包含进度圆环、状态卡片、动作按钮栏。
        与 ENABLE_LVGL_SAMPLE 互斥（共用硬件和 LVGL）。

if ENABLE_LVGL_PANEL
source "deprecated/ws63_screen_panel_lvgl/Kconfig"
endif

config ENABLE_SD_CARD_TEST
    bool
    prompt "WS63 MSP3223 TF卡独立读取测试（不启动屏幕）"
    default n
    depends on SAMPLE_ENABLE
    select SPI_SUPPORT_MASTER
    help
        用途：只初始化共享 SPI 引脚、SD 卡和 FAT 根目录扫描，不启动
        LCD、LVGL、触摸、SLE 或激光控制，用于排查 MSP3223 板载 TF 卡座、
        MISO/CS/供电/卡格式等问题。
```

## src/application/samples/User/Kconfig
```kconfig
#===============================================================================
# @brief    User Samples Kconfig file.
#===============================================================================

config ENABLE_USER_SAMPLE
    bool
    prompt "Enable the Sample of User."
    default y
    help
        This option means enable the user defined samples.

# --- LED 示例的配置 ---
config SAMPLE_SUPPORT_MY_LED
    bool
    prompt "Support My LED Sample."
    default n
    depends on ENABLE_USER_SAMPLE
    help
        This option means support My LED Sample.

if SAMPLE_SUPPORT_MY_LED
menu "My LED Sample Configuration"
    osource "application/samples/User/led/Kconfig"
endmenu
endif

# User/Kconfig

# 1. 定义总开关
config SAMPLE_SUPPORT_MY_PWM
    bool
    prompt "Support My PWM Sample"
    default n
    depends on ENABLE_USER_SAMPLE
    help
        Enable the user defined PWM sample.

# 2. 引入子目录的详细配置（引脚选择）
if SAMPLE_SUPPORT_MY_PWM
    source "application/samples/User/pwm/Kconfig"
endif

# --- BUTTON 示例的配置 ---
config SAMPLE_SUPPORT_MY_BUTTON
    bool
    prompt "Support My Button Sample"
    default n
    depends on ENABLE_USER_SAMPLE
    help
        Enable the user defined Button sample.

if SAMPLE_SUPPORT_MY_BUTTON
    source "application/samples/User/button/Kconfig"
endif

# --- USART 示例的配置 ---
config SAMPLE_SUPPORT_MY_USART
    bool
    prompt "Support My USART Sample"
    default n
    depends on ENABLE_USER_SAMPLE
    help
        Enable the user defined USART sample.

if SAMPLE_SUPPORT_MY_USART
    source "application/samples/User/usart/Kconfig"
endif

# 以后如果你增加了 OLED，就在下面继续添加：
# config SAMPLE_SUPPORT_MY_OLED
# ... 依此类推
```

## src/application/samples/User/button/Kconfig
```kconfig
#===============================================================================
# User/button/Kconfig

config MY_BUTTON_PIN
    int
    prompt "Choose My Button pin."
    depends on SAMPLE_SUPPORT_MY_BUTTON
    default 14
    help
        Set the GPIO pin number for your button input.

config MY_BUTTON_LED_PIN
    int
    prompt "Choose Button LED pin."
    depends on SAMPLE_SUPPORT_MY_BUTTON
    default 2
    help
        Set the GPIO pin number for the LED controlled by button.
```

## src/application/samples/User/led/Kconfig
```kconfig
config MY_LED_PIN
    int
    prompt "Choose my led pin."
    default 2
    help
        Set the GPIO pin number for your LED.
```

## src/application/samples/User/pwm/Kconfig
```kconfig
#===============================================================================
# User/pwm/Kconfig

config MY_PWM_PIN  # <--- 改名，避免和官方冲突
    int
    prompt "Choose My PWM pin."
    # 下面这一行非常关键：它依赖于父目录定义的开关
    depends on SAMPLE_SUPPORT_MY_PWM 
    default 2
    help
        Set the GPIO pin number for your PWM output.
```

## src/application/samples/User/usart/Kconfig
```kconfig
#===============================================================================
# User/usart/Kconfig
# USART Sample Configuration

config MY_USART_BUS_ID
    int
    prompt "Choose USART Bus ID."
    depends on SAMPLE_SUPPORT_MY_USART
    default 1
    help
        Set the USART bus ID (0, 1, or 2).

config MY_USART_TXD_PIN
    int
    prompt "Choose USART TXD pin."
    depends on SAMPLE_SUPPORT_MY_USART
    default 15
    help
        Set the GPIO pin number for USART TXD.

config MY_USART_RXD_PIN
    int
    prompt "Choose USART RXD pin."
    depends on SAMPLE_SUPPORT_MY_USART
    default 16
    help
        Set the GPIO pin number for USART RXD.

config MY_USART_TXD_PIN_MODE
    int
    prompt "Choose USART TXD pin mode."
    depends on SAMPLE_SUPPORT_MY_USART
    default 2
    help
        Set the pin mode for USART TXD pin.

config MY_USART_RXD_PIN_MODE
    int
    prompt "Choose USART RXD pin mode."
    depends on SAMPLE_SUPPORT_MY_USART
    default 2
    help
        Set the pin mode for USART RXD pin.

config MY_USART_USE_INT_MODE
    bool
    prompt "Use Interrupt Mode"
    depends on SAMPLE_SUPPORT_MY_USART
    default n
    help
        If enabled, use interrupt mode for USART communication.
        If disabled, use polling mode.
```

## src/application/samples/radar/Kconfig
```kconfig
#===============================================================================
# @brief    Kconfig file.
# Copyright (c) HiSilicon (Shanghai) Technologies Co., Ltd. 2023-2023. All rights reserved.
#===============================================================================
choice
    prompt "Sample"

config SUPPORT_RADAR_STA_SAMPLE
    bool "Support RADAR STA Sample"

config SUPPORT_RADAR_SOFTAP_SAMPLE
    bool "Support RADAR SoftAP Sample."

config SUPPORT_RADAR_WIRELESS_SAMPLE
    bool "Support RADAR WIRELESS Sample"

config SUPPORT_RADAR_SLP_SAMPLE
    bool "Support RADAR SLP Sample"

endchoice
```

## src/deprecated/ws63_laser_sle_bridge/Kconfig
```kconfig
#===============================================================================
# @brief WS63 laser SLE transparent bridge Kconfig
#===============================================================================

menu "WS63 Laser SLE Bridge Configuration"
    depends on ENABLE_LASER_SLE_BRIDGE_SAMPLE

choice
    prompt "SLE bridge board role (板卡角色)"
    default LASER_SLE_BRIDGE_RECEIVER

config LASER_SLE_BRIDGE_RECEIVER
    bool "Build RECEIVER firmware (接收板：唯一 Grbl 控制器)"
    select SPI_SUPPORT_MASTER
    help
        Build the receiver firmware. It is the only Grbl-compatible device,
        receives raw UART bytes through SLE, and executes laser motion locally.

config LASER_SLE_BRIDGE_TRANSMITTER
    bool "Build TRANSMITTER firmware (发射板：透明无线串口线)"
    help
        Build the transmitter firmware. It only bridges COM UART bytes and SLE
        bytes, without parsing G-code and without generating Grbl responses.

endchoice

comment "CURRENT BUILD TARGET: RECEIVER / 接收板固件"
    depends on LASER_SLE_BRIDGE_RECEIVER

comment "CURRENT BUILD TARGET: TRANSMITTER / 发射板固件"
    depends on LASER_SLE_BRIDGE_TRANSMITTER

comment "Bridge UART configuration"
config LASER_SLE_BRIDGE_UART_BAUD
    int
    prompt "LaserGRBL UART baud rate"
    range 9600 1000000
    default 115200

config LASER_SLE_BRIDGE_UART_BUS
    int
    prompt "LaserGRBL UART bus number"
    default 1

config LASER_SLE_BRIDGE_UART_TX_PIN
    int
    prompt "LaserGRBL UART TX pin"
    default 15

config LASER_SLE_BRIDGE_UART_RX_PIN
    int
    prompt "LaserGRBL UART RX pin"
    default 16

comment "Laser work area"
config LASER_SLE_BRIDGE_WORK_AREA_X_MM
    int
    prompt "Work area X size in mm"
    range 1 300
    default 70

config LASER_SLE_BRIDGE_WORK_AREA_Y_MM
    int
    prompt "Work area Y size in mm"
    range 1 300
    default 70

config LASER_SLE_BRIDGE_STATUS_PERIODIC
    bool
    prompt "Send periodic Grbl status reports"
    default n

endmenu
```

## src/deprecated/ws63_screen_panel_lvgl/Kconfig
```kconfig
#===============================================================================
# @brief WS63 Screen Panel LVGL Kconfig
#===============================================================================

menu "WS63 Panel UI 配置"
    depends on ENABLE_LVGL_PANEL

endmenu
```

## src/deprecated/ws63_screen_st7796_ft6336/Kconfig
```kconfig
#===============================================================================
# @brief WS63 ST7796 LCD + FT6336 touch screen Kconfig
#===============================================================================

menu "WS63 屏幕模块配置 (ST7796 + FT6336)"
    depends on ENABLE_SCREEN_SAMPLE

config SCREEN_LCD_WIDTH
    int "LCD 宽度（像素）"
    default 320

config SCREEN_LCD_HEIGHT
    int "LCD 高度（像素）"
    default 480

config SCREEN_LCD_SPI_FREQ_MHZ
    int "SPI 时钟频率（MHz）"
    default 10
    range 1 40
    help
        LCD SPI 时钟频率，单位 MHz。
        默认 10MHz，可根据屏幕规格调整。

config SCREEN_TOUCH_I2C_ADDR
    int "触摸 I2C 地址（7-bit）"
    default 0x38
    help
        FT6336 I2C 地址，默认 0x38。

endmenu
```

## src/vendor/DFRobot_Beetle_WS63/demo/beetle_urm37/Kconfig
```kconfig
#===============================================================================
# @brief    Kconfig file.
# Copyright (c) HiSilicon (Shanghai) Technologies Co., Ltd. 2023-2023. All rights reserved.
#===============================================================================

config URTRIG_PIN
    int "Choose URTRIG pin."
    default 7

config URECHO_PIN
    int "Choose URECHO pin."
    default 8
```

## src/vendor/Lierda-FB36/demo/sle_uart/Kconfig
```kconfig
#===============================================================================
# @brief    Kconfig file.
# Copyright (c) HiSilicon (Shanghai) Technologies Co., Ltd. 2023-2023. All rights reserved.
#===============================================================================

choice
    prompt "SLE UART Sample"

config SAMPLE_SUPPORT_SLE_UART_SERVER
    bool "Support SLE UART Server Sample."

config SAMPLE_SUPPORT_SLE_UART_CLIENT
    bool "Support SLE UART Client Sample."

endchoice
```

## src/ws63_laser_rx_unified/Kconfig
```kconfig
#===============================================================================
# @brief WS63 unified laser RX configuration
#===============================================================================

menu "WS63 Laser RX Unified Options"
    depends on LASER_RX_UNIFIED

config LASER_RX_TRANSPORT_UART
    bool "Enable USART Direct transport option"
    default n
    help
        Enable the Phase 2A USART Direct byte-stream input path.
        This starts a UART RX task and feeds bytes into the shared rx_stream.

config LASER_RX_UART_BAUD
    int "USART Direct baud rate"
    default 115200
    depends on LASER_RX_TRANSPORT_UART
    help
        UART baud rate for the direct PC-to-RX command stream. Keep 115200 for
        the demo-safe baseline unless explicitly testing a rebuilt firmware.

config LASER_RX_TRANSPORT_WIFI
    bool "Enable WiFi TCP transport option"
    default n
    help
        Phase 2A still only declares this option. No real WiFi TCP server is created yet.

config LASER_RX_TRANSPORT_SLE_JOB
    bool "Enable SLE job packet transport option"
    default n
    help
        Phase 2A still only declares this option. SLE job packet input is not wired yet.

config LASER_RX_WORK_AREA_X_MM
    int "Work area X in mm"
    default 70

config LASER_RX_WORK_AREA_Y_MM
    int "Work area Y in mm"
    default 70

endmenu
```

## src/ws63_laser_single/Kconfig
```kconfig
#===============================================================================
# @brief WS63 single-board laser marker Kconfig
#===============================================================================

menu "WS63 串口单板激光打标配置"
    depends on ENABLE_LASER_SINGLE_SAMPLE

comment "固定引脚分配: UART1 GPIO15/16, SPI0 GPIO7/9/10, PWM2 GPIO2"

config LASER_SINGLE_UART_BAUD
    int
    prompt "LaserGRBL 串口波特率"
    range 9600 1000000
    default 115200
    help
        设置与 LaserGRBL 通信的串口波特率。
        默认 115200，可根据上位机设置调整。

config LASER_SINGLE_WORK_AREA_X_MM
    int
    prompt "X轴工作区域（mm）"
    range 1 300
    default 70

config LASER_SINGLE_WORK_AREA_Y_MM
    int
    prompt "Y轴工作区域（mm）"
    range 1 300
    default 70

config LASER_SINGLE_STATUS_PERIODIC
    bool
    prompt "启用周期性状态报告"
    default n
    help
        启用后，控制器会定期发送Grbl状态报告。
        通常LaserGRBL会主动发送'?'查询状态，此选项一般不需要开启。

endmenu
```
